## libraries/3rdparty/espwho/esp-face/main/Kconfig
```kconfig
menu "ESP32 Hotword Detection"

choice SR_SOURCE
	prompt "Speech recognition audio source"
	default SR_SOURCE_WAV
	help
		Select the audio source for the speech recognition. Wav reads a wave file from a partition
		and parses it as soon as possible. Mic needs a Lyra-T board and will use the live microphone
		on that board.

config SR_SOURCE_WAV
	bool "Wav file from partition"

config SR_SOURCE_MIC
	bool "Live microphone on LyraT-board"

endchoice


choice SR_MODEL_SEL
	prompt "Speech recognition model to use"
	default SR_MODEL_WN1_FLOAT
	help
		Select the model to be used.

config SR_MODEL_WN1_FLOAT
	bool "WakeNet 1 (float)"

config SR_MODEL_WN1_QUANT
	bool "WakeNet 1 (quantized)"

config SR_MODEL_WN2_FLOAT
	bool "WakeNet 2 (float)"

config SR_MODEL_WN3_QUANT
	bool "WakeNet 3 (quantized)"

endchoice

#Indicates if the selected NN is float (y) or quantized (n). At the moment this is only used to show/hide
#the NN_CHECK_QUANTIZED_SANITY option.
config NN_NO_QUANTIZED
	bool
	default y if SR_MODEL_WN1_FLOAT
	default n if SR_MODEL_WN1_QUANT
	default y if SR_MODEL_WN2_FLOAT

config NN_CHECK_QUANTIZED_SANITY
	bool "Check sanity of quantized matrices"
	depends on !NN_NO_QUANTIZED
	default n
	help
		Checks if a lot of values in the quantized matrices are clipped, or if the bits in the mantissas
		are under-used. Check is run while doing neural network operations and can slow down the process 
		a fair amount.

endmenu
```

## tests/espressif/esp32_devkitc_esp_wrover_kit/make/sdkconfig.defaults
```kconfig
CONFIG_TASK_WDT=
CONFIG_INT_WDT=
CONFIG_SUPPORT_STATIC_ALLOCATION=y
CONFIG_ENABLE_STATIC_TASK_CLEAN_UP_HOOK=y
CONFIG_PARTITION_TABLE_CUSTOM=y
CONFIG_PARTITION_TABLE_CUSTOM_FILENAME="partitions_example.csv"
CONFIG_PARTITION_TABLE_FILENAME="partitions_example.csv"
CONFIG_ESP32_WIFI_STATIC_RX_BUFFER_NUM=16
CONFIG_ESP32_WIFI_DYNAMIC_RX_BUFFER_NUM=64
CONFIG_ESP32_WIFI_DYNAMIC_TX_BUFFER_NUM=64
CONFIG_TIMER_TASK_STACK_DEPTH=3584
CONFIG_TIMER_TASK_PRIORITY=6
CONFIG_ESPTOOLPY_FLASHSIZE_4MB=y
CONFIG_PTHREAD_MUTEX_TIMEDLOCK=y
CONFIG_MP_BLOB_SUPPORT=y
```

## vendors/espressif/boards/esp32/aws_demos/sdkconfig.defaults
```kconfig
CONFIG_FREERTOS_USE_TRACE_FACILITY=y
CONFIG_FREERTOS_SUPPORT_STATIC_ALLOCATION=y
CONFIG_FREERTOS_ENABLE_STATIC_TASK_CLEAN_UP=y
CONFIG_PARTITION_TABLE_CUSTOM=y
CONFIG_PARTITION_TABLE_CUSTOM_FILENAME="partition-table.csv"
CONFIG_PARTITION_TABLE_FILENAME="partition-table.csv"
CONFIG_TIMER_TASK_STACK_DEPTH=3584
CONFIG_FREERTOS_TIMER_TASK_PRIORITY=5
CONFIG_FREERTOS_LEGACY_HOOKS=y
CONFIG_FREERTOS_LEGACY_IDLE_HOOK=y
CONFIG_FREERTOS_LEGACY_TICK_HOOK=y
CONFIG_ESPTOOLPY_FLASHSIZE_4MB=y
CONFIG_MBEDTLS_ASYMMETRIC_CONTENT_LEN=y
CONFIG_MBEDTLS_SSL_IN_CONTENT_LEN=8192
CONFIG_MBEDTLS_SSL_OUT_CONTENT_LEN=4096
CONFIG_MBEDTLS_CMAC_C=y
CONFIG_MBEDTLS_ECP_RESTARTABLE=y
CONFIG_BT_ENABLED=y
CONFIG_BT_BLUEDROID_ENABLED=
CONFIG_NIMBLE_ENABLED=y
CONFIG_NIMBLE_MAX_CONNECTIONS=1
CONFIG_NIMBLE_MAX_BONDS=3
CONFIG_NIMBLE_MAX_CCCDS=30
CONFIG_NIMBLE_L2CAP_COC_MAX_NUM=0
CONFIG_NIMBLE_PINNED_TO_CORE=0
CONFIG_NIMBLE_ROLE_CENTRAL=y
CONFIG_NIMBLE_ROLE_PERIPHERAL=y
CONFIG_NIMBLE_ROLE_BROADCASTER=y
CONFIG_NIMBLE_ROLE_OBSERVER=y
CONFIG_NIMBLE_NVS_PERSIST=y
CONFIG_NIMBLE_SM_LEGACY=y
CONFIG_NIMBLE_SM_SC=y
CONFIG_NIMBLE_DEBUG=
CONFIG_NIMBLE_SVC_GAP_DEVICE_NAME="nimble"
CONFIG_NIMBLE_GAP_DEVICE_NAME_MAX_LEN=31
CONFIG_NIMBLE_ATT_PREFERRED_MTU=256
CONFIG_NIMBLE_SVC_GAP_APPEARANCE=0x0
CONFIG_NIMBLE_ACL_BUF_COUNT=12
CONFIG_NIMBLE_ACL_BUF_SIZE=255
CONFIG_NIMBLE_HCI_EVT_BUF_SIZE=70
CONFIG_NIMBLE_HCI_EVT_HI_BUF_COUNT=30
CONFIG_NIMBLE_HCI_EVT_LO_BUF_COUNT=8
CONFIG_NIMBLE_MESH=
CONFIG_MBEDTLS_TLS_CLIENT_ONLY=y
CONFIG_ESPTOOLPY_BAUD_921600B=y
CONFIG_BOOTLOADER_WDT_DISABLE_SKIP_FIRST_BOOT=y
CONFIG_BOOTLOADER_WDT_TIME_MS=90000
CONFIG_BOOTLOADER_APP_ROLLBACK_ENABLE=y
CONFIG_MBEDTLS_THREADING_ALT=y
CONFIG_MBEDTLS_THREADING_C=y
CONFIG_MBEDTLS_ECDSA_DETERMINISTIC=n
CONFIG_MBEDTLS_SHA512_C=n
CONFIG_ESP_NETIF_TCPIP_ADAPTER_COMPATIBLE_LAYER=n
CONFIG_COMPILER_DISABLE_GCC8_WARNINGS=y
CONFIG_ESP_INT_WDT=y
CONFIG_ESP_INT_WDT_TIMEOUT_MS=300
CONFIG_ESP_TASK_WDT=y
CONFIG_ESP_TASK_WDT_TIMEOUT_S=20
CONFIG_ESP_TASK_WDT_CHECK_IDLE_TASK_CPU0=y
```

## vendors/espressif/boards/esp32/aws_tests/sdkconfig.defaults
```kconfig
CONFIG_ESP_INT_WDT=
CONFIG_ESP_TASK_WDT=
CONFIG_FREERTOS_SUPPORT_STATIC_ALLOCATION=y
CONFIG_FREERTOS_ENABLE_STATIC_TASK_CLEAN_UP=y
CONFIG_PARTITION_TABLE_CUSTOM=y
CONFIG_PARTITION_TABLE_CUSTOM_FILENAME="partition-table.csv"
CONFIG_PARTITION_TABLE_FILENAME="partition-table.csv"
CONFIG_ESP32_WIFI_STATIC_RX_BUFFER_NUM=16
CONFIG_ESP32_WIFI_DYNAMIC_RX_BUFFER_NUM=64
CONFIG_ESP32_WIFI_DYNAMIC_TX_BUFFER_NUM=64
CONFIG_TIMER_TASK_STACK_DEPTH=3584
CONFIG_FREERTOS_TIMER_TASK_PRIORITY=6
CONFIG_ESPTOOLPY_FLASHSIZE_4MB=y
CONFIG_PTHREAD_MUTEX_TIMEDLOCK=
CONFIG_MBEDTLS_ASYMMETRIC_CONTENT_LEN=y
CONFIG_MBEDTLS_SSL_IN_CONTENT_LEN=8192
CONFIG_MBEDTLS_SSL_OUT_CONTENT_LEN=4096
CONFIG_MBEDTLS_CMAC_C=y
CONFIG_MBEDTLS_ECP_RESTARTABLE=y
CONFIG_BT_ENABLED=y
CONFIG_BT_BLUEDROID_ENABLED=
CONFIG_NIMBLE_ENABLED=y
CONFIG_NIMBLE_MAX_CONNECTIONS=1
CONFIG_NIMBLE_MAX_BONDS=3
CONFIG_NIMBLE_MAX_CCCDS=30
CONFIG_NIMBLE_L2CAP_COC_MAX_NUM=0
CONFIG_NIMBLE_PINNED_TO_CORE=0
CONFIG_NIMBLE_ROLE_CENTRAL=y
CONFIG_NIMBLE_ROLE_PERIPHERAL=y
CONFIG_NIMBLE_ROLE_BROADCASTER=y
CONFIG_NIMBLE_ROLE_OBSERVER=y
CONFIG_NIMBLE_NVS_PERSIST=y
CONFIG_NIMBLE_SM_LEGACY=y
CONFIG_NIMBLE_SM_SC=y
CONFIG_NIMBLE_DEBUG=
CONFIG_NIMBLE_SVC_GAP_DEVICE_NAME="nimble"
CONFIG_NIMBLE_GAP_DEVICE_NAME_MAX_LEN=31
CONFIG_NIMBLE_ATT_PREFERRED_MTU=256
CONFIG_NIMBLE_SVC_GAP_APPEARANCE=0x0
CONFIG_NIMBLE_ACL_BUF_COUNT=12
CONFIG_NIMBLE_ACL_BUF_SIZE=255
CONFIG_NIMBLE_HCI_EVT_BUF_SIZE=70
CONFIG_NIMBLE_HCI_EVT_HI_BUF_COUNT=30
CONFIG_NIMBLE_HCI_EVT_LO_BUF_COUNT=8
CONFIG_NIMBLE_MESH=
CONFIG_FREERTOS_LEGACY_IDLE_HOOK=
CONFIG_FREERTOS_LEGACY_TICK_HOOK=
CONFIG_FREERTOS_USE_TRACE_FACILITY=y
CONFIG_MBEDTLS_TLS_CLIENT_ONLY=y
CONFIG_ESPTOOLPY_BAUD_921600B=y
CONFIG_LWIP_MAX_ACTIVE_TCP=32
CONFIG_MBEDTLS_THREADING_ALT=y
CONFIG_MBEDTLS_THREADING_C=y
CONFIG_MBEDTLS_ECDSA_DETERMINISTIC=n
CONFIG_MBEDTLS_SHA512_C=n
CONFIG_ESP_NETIF_TCPIP_ADAPTER_COMPATIBLE_LAYER=n
CONFIG_COMPILER_DISABLE_GCC8_WARNINGS=y
```

## vendors/espressif/boards/esp32s2/aws_demos/sdkconfig.defaults
```kconfig
CONFIG_FREERTOS_USE_TRACE_FACILITY=y
CONFIG_FREERTOS_USE_STATS_FORMATTING_FUNCTIONS=y
CONFIG_FREERTOS_SUPPORT_STATIC_ALLOCATION=y
CONFIG_FREERTOS_ENABLE_STATIC_TASK_CLEAN_UP=y
CONFIG_PARTITION_TABLE_CUSTOM=y
CONFIG_PARTITION_TABLE_CUSTOM_FILENAME="partition-table.csv"
CONFIG_PARTITION_TABLE_FILENAME="partition-table.csv"
CONFIG_TIMER_TASK_STACK_DEPTH=3584
CONFIG_FREERTOS_TIMER_TASK_PRIORITY=5
CONFIG_FREERTOS_LEGACY_HOOKS=y
CONFIG_FREERTOS_LEGACY_IDLE_HOOK=y
CONFIG_FREERTOS_LEGACY_TICK_HOOK=y
CONFIG_ESPTOOLPY_FLASHSIZE_4MB=y
CONFIG_MBEDTLS_ASYMMETRIC_CONTENT_LEN=y
CONFIG_MBEDTLS_SSL_IN_CONTENT_LEN=8192
CONFIG_MBEDTLS_SSL_OUT_CONTENT_LEN=4096
CONFIG_MBEDTLS_CMAC_C=y
CONFIG_MBEDTLS_ECP_RESTARTABLE=y
CONFIG_MBEDTLS_TLS_CLIENT_ONLY=y
CONFIG_ESPTOOLPY_BAUD_921600B=y
CONFIG_HTTPD_MAX_URI_LEN=512
CONFIG_BOOTLOADER_WDT_DISABLE_SKIP_FIRST_BOOT=y
CONFIG_BOOTLOADER_WDT_TIME_MS=90000
CONFIG_BOOTLOADER_APP_ROLLBACK_ENABLE=y
CONFIG_MBEDTLS_THREADING_ALT=y
CONFIG_MBEDTLS_THREADING_C=y
CONFIG_MBEDTLS_ECDSA_DETERMINISTIC=n
CONFIG_MBEDTLS_SHA512_C=n
CONFIG_ESP_NETIF_TCPIP_ADAPTER_COMPATIBLE_LAYER=n
CONFIG_COMPILER_DISABLE_GCC8_WARNINGS=y
CONFIG_ESP_INT_WDT=y
CONFIG_ESP_INT_WDT_TIMEOUT_MS=300
CONFIG_ESP_TASK_WDT=y
CONFIG_ESP_TASK_WDT_TIMEOUT_S=20
CONFIG_ESP_TASK_WDT_CHECK_IDLE_TASK_CPU0=y

# ESP32-S2 specific memory optimizations
CONFIG_ESP32_WIFI_STATIC_RX_BUFFER_NUM=8
CONFIG_ESP32_WIFI_DYNAMIC_RX_BUFFER_NUM=8
CONFIG_ESP32_WIFI_DYNAMIC_TX_BUFFER_NUM=8
CONFIG_ESP32_WIFI_IRAM_OPT=n
CONFIG_ESP32_WIFI_RX_IRAM_OPT=n
CONFIG_LWIP_MAX_SOCKETS=5
CONFIG_COMPILER_OPTIMIZATION_SIZE=y
```

## vendors/espressif/boards/esp32s2/aws_tests/sdkconfig.defaults
```kconfig
CONFIG_ESP_INT_WDT=
CONFIG_ESP_TASK_WDT=
CONFIG_FREERTOS_SUPPORT_STATIC_ALLOCATION=y
CONFIG_FREERTOS_ENABLE_STATIC_TASK_CLEAN_UP=y
CONFIG_PARTITION_TABLE_CUSTOM=y
CONFIG_PARTITION_TABLE_CUSTOM_FILENAME="partition-table.csv"
CONFIG_PARTITION_TABLE_FILENAME="partition-table.csv"
CONFIG_ESP32_WIFI_STATIC_RX_BUFFER_NUM=16
CONFIG_ESP32_WIFI_DYNAMIC_RX_BUFFER_NUM=64
CONFIG_ESP32_WIFI_DYNAMIC_TX_BUFFER_NUM=64
CONFIG_TIMER_TASK_STACK_DEPTH=3584
CONFIG_FREERTOS_TIMER_TASK_PRIORITY=6
CONFIG_ESPTOOLPY_FLASHSIZE_4MB=y
CONFIG_PTHREAD_MUTEX_TIMEDLOCK=
CONFIG_MBEDTLS_ASYMMETRIC_CONTENT_LEN=y
CONFIG_MBEDTLS_SSL_IN_CONTENT_LEN=8192
CONFIG_MBEDTLS_SSL_OUT_CONTENT_LEN=4096
CONFIG_MBEDTLS_CMAC_C=y
CONFIG_MBEDTLS_ECP_RESTARTABLE=y
CONFIG_FREERTOS_LEGACY_IDLE_HOOK=
CONFIG_FREERTOS_LEGACY_TICK_HOOK=
CONFIG_FREERTOS_USE_TRACE_FACILITY=y
CONFIG_MBEDTLS_TLS_CLIENT_ONLY=y
CONFIG_ESPTOOLPY_BAUD_921600B=y
CONFIG_LWIP_MAX_ACTIVE_TCP=32
CONFIG_MBEDTLS_THREADING_ALT=y
CONFIG_MBEDTLS_THREADING_C=y
CONFIG_MBEDTLS_ECDSA_DETERMINISTIC=n
CONFIG_MBEDTLS_SHA512_C=n
CONFIG_ESP_NETIF_TCPIP_ADAPTER_COMPATIBLE_LAYER=n
CONFIG_COMPILER_DISABLE_GCC8_WARNINGS=y
```
