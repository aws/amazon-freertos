## demos/espressif/esp32_devkitc_esp_wrover_kit/make/sdkconfig.defaults
```kconfig
CONFIG_INT_WDT=
CONFIG_TASK_WDT=
CONFIG_FREERTOS_USE_TRACE_FACILITY=y
CONFIG_SUPPORT_STATIC_ALLOCATION=y
CONFIG_ENABLE_STATIC_TASK_CLEAN_UP_HOOK=y
CONFIG_PARTITION_TABLE_CUSTOM=y
CONFIG_PARTITION_TABLE_CUSTOM_FILENAME="partitions_example.csv"
CONFIG_PARTITION_TABLE_FILENAME="partitions_example.csv"
CONFIG_TIMER_TASK_STACK_DEPTH=3584
CONFIG_TIMER_TASK_PRIORITY=5
CONFIG_PARTITION_TABLE_CUSTOM_APP_BIN_OFFSET=0x20000
CONFIG_APP_OFFSET=0x20000
CONFIG_FREERTOS_LEGACY_HOOKS=y
CONFIG_FREERTOS_LEGACY_IDLE_HOOK=y
CONFIG_FREERTOS_LEGACY_TICK_HOOK=y
```

## demos/espressif/esp32_devkitc_esp_wrover_kit_trustx/make/sdkconfig.defaults
```kconfig
CONFIG_INT_WDT=
CONFIG_TASK_WDT=
CONFIG_FREERTOS_USE_TRACE_FACILITY=y
CONFIG_SUPPORT_STATIC_ALLOCATION=y
CONFIG_ENABLE_STATIC_TASK_CLEAN_UP_HOOK=y
CONFIG_PARTITION_TABLE_CUSTOM=y
CONFIG_PARTITION_TABLE_CUSTOM_FILENAME="partitions_example.csv"
#CONFIG_PARTITION_TABLE_CUSTOM_APP_BIN_OFFSET=0x10000
CONFIG_PARTITION_TABLE_FILENAME="partitions_example.csv"
CONFIG_APP_OFFSET=0x10000
CONFIG_TIMER_TASK_STACK_DEPTH=3584
CONFIG_TIMER_TASK_PRIORITY=5
CONFIG_PARTITION_TABLE_CUSTOM_APP_BIN_OFFSET=0x20000
CONFIG_APP_OFFSET=0x20000
CONFIG_FREERTOS_LEGACY_HOOKS=y
CONFIG_FREERTOS_LEGACY_IDLE_HOOK=y
CONFIG_FREERTOS_LEGACY_TICK_HOOK=y


#
# ESP32-specific
#
CONFIG_ESP32_DEFAULT_CPU_FREQ_80=y
CONFIG_ESP32_DEFAULT_CPU_FREQ_160=
CONFIG_ESP32_DEFAULT_CPU_FREQ_240=
CONFIG_ESP32_DEFAULT_CPU_FREQ_MHZ=80
CONFIG_SYSTEM_EVENT_TASK_STACK_SIZE=4096
CONFIG_MAIN_TASK_STACK_SIZE=4096
#
# FreeRTOS
#
CONFIG_FREERTOS_HZ=1000

#
# mbedTLS
#
CONFIG_MBEDTLS_SSL_MAX_CONTENT_LEN=4096
CONFIG_MBEDTLS_DEBUG=
CONFIG_MBEDTLS_HARDWARE_AES=y
CONFIG_MBEDTLS_HARDWARE_MPI=
CONFIG_MBEDTLS_HARDWARE_SHA=
CONFIG_MBEDTLS_HAVE_TIME=y
CONFIG_MBEDTLS_HAVE_TIME_DATE=
CONFIG_MBEDTLS_TLS_SERVER_AND_CLIENT=y
CONFIG_MBEDTLS_TLS_SERVER_ONLY=
CONFIG_MBEDTLS_TLS_CLIENT_ONLY=
CONFIG_MBEDTLS_TLS_DISABLED=
CONFIG_MBEDTLS_TLS_SERVER=y
CONFIG_MBEDTLS_TLS_CLIENT=y
CONFIG_MBEDTLS_TLS_ENABLED=y

#
# TLS Key Exchange Methods
#
CONFIG_MBEDTLS_PSK_MODES=
CONFIG_MBEDTLS_KEY_EXCHANGE_RSA=
CONFIG_MBEDTLS_KEY_EXCHANGE_DHE_RSA=
CONFIG_MBEDTLS_KEY_EXCHANGE_ELLIPTIC_CURVE=y
CONFIG_MBEDTLS_KEY_EXCHANGE_ECDHE_RSA=
CONFIG_MBEDTLS_KEY_EXCHANGE_ECDHE_ECDSA=y
CONFIG_MBEDTLS_KEY_EXCHANGE_ECDH_ECDSA=
CONFIG_MBEDTLS_KEY_EXCHANGE_ECDH_RSA=
CONFIG_MBEDTLS_SSL_RENEGOTIATION=y
CONFIG_MBEDTLS_SSL_PROTO_SSL3=
CONFIG_MBEDTLS_SSL_PROTO_TLS1=
CONFIG_MBEDTLS_SSL_PROTO_TLS1_1=
CONFIG_MBEDTLS_SSL_PROTO_TLS1_2=y
CONFIG_MBEDTLS_SSL_PROTO_DTLS=
CONFIG_MBEDTLS_SSL_ALPN=y
CONFIG_MBEDTLS_SSL_SESSION_TICKETS=y

#
# Symmetric Ciphers
#
CONFIG_MBEDTLS_AES_C=y
CONFIG_MBEDTLS_CAMELLIA_C=
CONFIG_MBEDTLS_DES_C=
CONFIG_MBEDTLS_RC4_DISABLED=y
CONFIG_MBEDTLS_RC4_ENABLED_NO_DEFAULT=
CONFIG_MBEDTLS_RC4_ENABLED=
CONFIG_MBEDTLS_BLOWFISH_C=
CONFIG_MBEDTLS_XTEA_C=
CONFIG_MBEDTLS_CCM_C=y
CONFIG_MBEDTLS_GCM_C=y
CONFIG_MBEDTLS_RIPEMD160_C=

#
# Certificates
#
CONFIG_MBEDTLS_PEM_PARSE_C=y
CONFIG_MBEDTLS_PEM_WRITE_C=y
CONFIG_MBEDTLS_X509_CRL_PARSE_C=y
CONFIG_MBEDTLS_X509_CSR_PARSE_C=y
CONFIG_MBEDTLS_ECP_C=y
CONFIG_MBEDTLS_ECDH_C=y
CONFIG_MBEDTLS_ECDSA_C=y
CONFIG_MBEDTLS_ECP_DP_SECP192R1_ENABLED=
CONFIG_MBEDTLS_ECP_DP_SECP224R1_ENABLED=
CONFIG_MBEDTLS_ECP_DP_SECP256R1_ENABLED=y
CONFIG_MBEDTLS_ECP_DP_SECP384R1_ENABLED=
CONFIG_MBEDTLS_ECP_DP_SECP521R1_ENABLED=
CONFIG_MBEDTLS_ECP_DP_SECP192K1_ENABLED=
CONFIG_MBEDTLS_ECP_DP_SECP224K1_ENABLED=
CONFIG_MBEDTLS_ECP_DP_SECP256K1_ENABLED=
CONFIG_MBEDTLS_ECP_DP_BP256R1_ENABLED=
CONFIG_MBEDTLS_ECP_DP_BP384R1_ENABLED=
CONFIG_MBEDTLS_ECP_DP_BP512R1_ENABLED=
CONFIG_MBEDTLS_ECP_DP_CURVE25519_ENABLED=
CONFIG_MBEDTLS_ECP_NIST_OPTIM=y
```

## lib/third_party/mcu_vendor/marvell/WMSDK/mw320/sdk/src/drivers/Kconfig
```kconfig
menu "I2C configuration"
menu "I2C debug options"

config DRV_I2C_DEBUG_DUMP
       bool "Dump all I/O bytes"
       def_bool n
       help
	Enabling this will help the developer
	debug I2C I/O packets. All the bytes
	going in or out of the module will
	be dumped onto the console.

endmenu
endmenu
```

## lib/third_party/mcu_vendor/marvell/WMSDK/mw320/sdk/src/wlan/Kconfig
```kconfig
menu "WLAN"

menu "Wifi driver"
config FILTER_LOCALLY_ADMINISTERED_AND_SELF_MAC_ADDR
       bool "Filter Locally Administered and Self Mac Address"
       def_bool n
       help
         This option enables the filtering of the locally administered
	 MAC address and Self address packets.
	 Say Y if you wish to enable this feature.

config HOST_PMK
       bool "Host PMK calculation Support"
       select ENABLE_TLS
       def_bool n
       help
         This option enables the use of host based PMK calculation.
	 Say Y if you wish to enable this feature.

config WLAN_BRIDGE
       bool "Wlan bridge support"
       def_bool n
       help
         This option enables wlan bridge function.

config EXT_SCAN
       bool "Extended Scan Support"
       def_bool n
       help
         This option enables the use of extended scan support. Say Y if you
	 wish to enable this feature.

config WMM
       bool "802.11 WMM Support"
       def_bool y
       help
         This option enables the use of 802.11 WMM support. Say Y if you
	 wish to enable this feature.

config 11N
       bool "802.11n support"
       select WMM
       select STA_AMPDU_RX
       def_bool y
       help
         This option enables the use of 802.11n support. Say Y if you
	 wish to use this feature. Please note that this feature
	 does not provide all 11n functionality. As of now only the
	 association with 11n-only APs is supported.

config STA_AMPDU_TX
	bool "AMPDU TX support"
	def_bool n
	depends on 11N
	help
	  This option enables the use of AMPDU feature when station is
	  a transmitter. Say Y if you wish to use this feature.

config NETWORK_HIGH_PERF
	bool "Network High Performance Configuration"
	def_bool n
	help
	This option sets up network high performance
	configuration. Say Y if you wish to use this feature.
        Note this config optio nwhen enabled  consumes huge buffers.

config STA_AMPDU_RX
	bool "AMPDU RX support"
	def_bool n
	depends on 11N
	help
	This option enables the use of AMPDU feature when station is
	  a receiver. Say Y if you wish to use this feature.

config WLAN_FW_HEARTBEAT
	bool "WLAN FW Heartbeat Event Support"
	def_bool y
	help
	  This option enables support for heartbeat event to be sent to the
	  WLAN firmware periodically. This helps in identifying and taking
	  corrective action in case the WLAN firmware is inactive or
	  unresponsive.

config 5GHz_SUPPORT
       bool "5GHz Support(Band A)"
       def_bool n
       help
         This option enables the use of 5GHz. Say Y if you
	 wish to enable this feature.

config WLAN_FAST_PATH
       bool "WiFi Fast Path"
       def_bool y
       help
	 This option helps fast WiFi connection by caching earlier scan result.

config MAX_AP_ENTRIES
       int  "Maximum scan entries"
       range 1 30
       default 20
       help
	This is the maximum number of entries in the
	list of APs stored by wifi driver. Each entry takes
	about 400 bytes of RAM. The value should
	be decided based on number of AP's expected
	to be present in the end user environment.
	Note that the wifi driver automatically keeps
	only the highest signal strength APs in the list.

config WLAN_KNOWN_NETWORKS
       int "Max Network Profiles"
       range 1 10
       default 5
       help
		WLC manager keeps a list of known networks.
		 These include the ones added using the wlan-add
		 command and one loaded from the psm. This
		 configuration defines the size of that list. Note
		 that this is not the size of the scan entries.

menu "uAP configuration"
config WIFI_UAP_WORKAROUND_STICKY_TIM
       def_bool y
       help
	This config enables the workaround of a
	particular firmware issue which causes packets
   	being sent on air even if STA is in IEEE PS. When
	enabled this will enable the sticky TIM bit
 	workaround. A downside of this is that the STA
	client of the uAP will not be able to go in IEEE PS.

config UAP_AMPDU_TX
	bool "AMPDU TX support"
	def_bool n
	depends on 11N
	help
	  This option enables the use of AMPDU feature when uAP is
	  a transmitter. Say Y if you wish to use this feature.

config UAP_AMPDU_RX
	bool "AMPDU RX support"
	def_bool n
	depends on 11N
	help
	  This option enables the use of AMPDU feature when uAP is
	  a receiver. Say Y if you wish to use this feature.
endmenu

menu "Wifi extra debug options"
config WIFI_EXTRA_DEBUG
       bool "Enable extra debug"
       default n
       help
	This macro helps you to get additional debugging
	information from the wifi driver. For e.g. more
	detailed reason will be given if an assoc failure
	happens.

config WIFI_UAP_DEBUG
       bool "Enable uAP debug"
       default n
       depends on WIFI_EXTRA_DEBUG
       help
		Enabling this will print out logs related
		to the uAP. This is enable to developer
		to localize issues related to uAP. Apart from
		other logs, uAP initialization and configuration
		logs are printed out.

config WIFI_EVENTS_DEBUG
       bool "Dump event information"
       default n
       depends on WIFI_EXTRA_DEBUG
       help
		Enabling this will dump event codes of
		events received on from the firmware.
		This helps the developer to checks the
		events received from the firmware along
		with their timestamp.

config WIFI_CMD_RESP_DEBUG
       bool "Dump command and response codes"
       default n
       depends on WIFI_EXTRA_DEBUG
       help
		Enabling this will dump command and response
		codes send to and received from firmware
		respectively. Timestamp will also be printed
		help localize timing issues.

config WIFI_SCAN_DEBUG
       bool "Scan debug"
       default n
       depends on WIFI_EXTRA_DEBUG
       help
		Enabling this will enable scan code logs
		This helps the developer to localize wlan
		scan related issues like split scan, channel
		selections, etc

config WIFI_IO_INFO_DUMP
       bool "Input-Output debug (basic)"
       default n
       depends on WIFI_EXTRA_DEBUG
       help
		Enabling this will dump information
		about input/ouput data packets. This information
		has information like packet size and interface
		for which packet is destined.

config WIFI_IO_DEBUG
       bool "Input-Output debug (advanced)"
       default n
       depends on WIFI_EXTRA_DEBUG
       help
		Enabling this will enable I/O debugging
		of wifi driver. This enables you to see
		how the driver is interacting with the
		SDIO bus.

config WIFI_IO_DUMP
       bool "Hex Dump packets"
       default n
       depends on WIFI_EXTRA_DEBUG
       help
		Enabling this will enable I/O debugging
		of wifi driver. This enables you to see
		all the packets that are received/sent from/to
		the SDIO bus.

config WIFI_MEM_DEBUG
       bool "Allocations debug"
       default n
       depends on WIFI_EXTRA_DEBUG
       help
		Enabling this will enable monitoring
		memory allocations and free's done by
		the wifi driver. This enables you to gauge
		and/or debug heap memory used by the driver.

config WIFI_AMPDU_DEBUG
       bool "AMPDU debug"
       default n
       depends on WIFI_EXTRA_DEBUG
       help
		Enabling this will help you to  monitor what
		is happening to AMPDU Rx packets. Note
		that AMPDU Tx is not supported by the driver. Note that
		you will need to enable timer debug separately to see
		timer activity going on during out of order packets
		handling.

config WIFI_TIMER_DEBUG
       bool "Timers debug"
       default n
       depends on WIFI_EXTRA_DEBUG
       help
       	 Enable this to monitor timer activity of the
	 driver. Timers are generally used for AMPDU out of
	 order packet handling. It is also used for command
	 timeout related functionality.

config WIFI_SDIO_DEBUG
       bool "SDIO debug"
       default n
       depends on WIFI_EXTRA_DEBUG
       help
	Enable this to monitor SDIO driver read write errors
	 for data and command operations.

endmenu

endmenu

config P2P
       bool "WiFi Direct support (P2P)"
       select WPS2
       def_bool n
       help
	This option enables the use of P2P APIs. Say Y if you
	wish to enable this feature.  This is a standard that
	allows Wi-Fi devices to connect to each other
	without the need for a wireless access point.

config WPS2
       bool "WPS 2.0 support"
       select ENABLE_TLS
       def_bool n
       help
         This option enables the use of WPS 2.0 APIs.
	 Say Y if you wish to enable this feature. This is
	 a computing standard that attempts to allow
	 easy establishment of a secure wireless home network.

menu "WPA2 Enterprise Support"
config WPA2_ENTP
       bool "WPA2 Enterprise"
       select WPS2
       select ENABLE_TLS
       def_bool n
       help
	This option enables the use of WPA2 Enterprise security support.
	Say Y if you wish to enable this feature. This is a standard
	that allows Wi-Fi devices to connect to WPA2 Enterprise enabled
	wireless access points.

choice
	prompt "Method"
	default EAP_TLS

config EAP_TLS
       bool "EAP-TLS"
       depends WPS2
       depends ENABLE_TLS
       depends WPA2_ENTP
       help
	This option enables the use of EAP-TLS in WPA2 Enterprise mode.

config PEAP_MSCHAPV2
       bool "PEAP-MSCHAPV2"
       depends WPS2
       depends ENABLE_TLS
       depends WPA2_ENTP
       help
	This option enables the use of PEAP-MSCHAPV2 in WPA2 Enterprise mode.

endchoice

choice
	prompt "RADIUS Server"
	default FREE_RADIUS

config HOSTAPD_RADIUS
       bool "HostapdRADIUS"
       depends WPS2
       depends ENABLE_TLS
       depends WPA2_ENTP
       help
	Select this option if you want to use Hostapd based RADIUS server
	 for EAP-TLS authentication

config FREE_RADIUS
       bool "FreeRADIUS"
       depends WPS2
       depends ENABLE_TLS
       depends WPA2_ENTP
       help
	Select this option if you want to use FreeRADIUS server for
	 EAP-TLS authentication

endchoice
endmenu

config MLAN_WMSDK
       def_bool y
       help
	This macro helps enable a subset of MLAN
	 part needed for us. This macro is not user.
	 visible. Please ensure that this macro
	 is always enabled.

endmenu
```

## libraries/3rdparty/espwho/esp-face/Kconfig
```kconfig
choice CONV_IMPL
    bool "Convolution Implementation"
    default XTENSA_IMPL
      
config C_IMPL
	bool "ANSI Implementation for general platforms"

config XTENSA_IMPL
	bool "Xtensa Implementation for ESP"
	
endchoice



menu "ESP-FACE Configuration"

    choice DETECTION_MODEL
        bool "Detection Model"
        default MTMN_LITE_QUANT

        config MTMN_LITE_QUANT
            bool "MTMN lite in quantization"
        
        config MTMN_LITE_FLOAT
            bool "MTMN lite in float"

        config MTMN_HEAVY_QUANT
            bool "MTMN heavy in quantization"
    endchoice

    choice RECOGNITION_MODEL
        bool "Recognition Model"
        default FRMN1_QUANT

        config FRMN1_QUANT
            bool "FRMN1"
        config FRMN2_QUANT
            bool "FRMN2"
        config FRMN2P_QUANT
            bool "FRMN2P"
        config FRMN2C_QUANT
            bool "FRMN2C"
    endchoice
    
endmenu
```
